## app/boards/my_own_board/Kconfig.defconfig
```kconfig
#created by gopi

if BOARD_MY_OWN_BOARD

config SPI_STM32_INTERRUPT
    default y
    depends on SPI

endif # BOARD_MY_OWN_BOARD
```

## app/boards/our_board/Kconfig.our_board
```kconfig
# Copyright (c) 2018 Philémon Jaermann
# SPDX-License-Identifier: Apache-2.0

config BOARD_OUR_BOARD		#changed by Gopi
	select SOC_STM32F446XX
```

## app/boards/our_board/board.yml
```yaml
board:
  name: our_board   #Changed by Gopi
  full_name: Our Board
  vendor: Gopi Boards
  socs:
    - name: stm32f446xx   #We are not changing the soc, because it same [ lol : all others are also same, but used my name :) ]
```
